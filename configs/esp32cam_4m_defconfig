## configs/esp32cam_4m_defconfig
```kconfig
BR2_xtensa=y
BR2_XTENSA_DYNCONFIG=y
BR2_TOOLCHAIN_EXTERNAL=y
BR2_TOOLCHAIN_EXTERNAL_CUSTOM_PREFIX="$(ARCH)-esp32-linux-uclibcfdpic"
BR2_TOOLCHAIN_EXTERNAL_HEADERS_6_6=y
BR2_TOOLCHAIN_EXTERNAL_WCHAR=y
BR2_TOOLCHAIN_EXTERNAL_HAS_SSP=y
BR2_OPTIMIZE_S=y
BR2_SSP_NONE=y
BR2_RELRO_NONE=y
BR2_ROOTFS_OVERLAY="rootfs_overlay"
BR2_LINUX_KERNEL=y
BR2_LINUX_KERNEL_CUSTOM_GIT=y
BR2_LINUX_KERNEL_CUSTOM_REPO_URL="https://github.com/jcmvbkbc/linux-xtensa.git"
BR2_LINUX_KERNEL_CUSTOM_REPO_VERSION="xtensa-6.11-esp32-tag"
BR2_LINUX_KERNEL_USE_CUSTOM_CONFIG=y
BR2_LINUX_KERNEL_CUSTOM_CONFIG_FILE="configs/esp32cam_4m_linux.config"
BR2_LINUX_KERNEL_IMAGE_TARGET_CUSTOM=y
BR2_LINUX_KERNEL_IMAGE_TARGET_NAME="xipImage"
BR2_LINUX_KERNEL_NEEDS_HOST_OPENSSL=y
BR2_PACKAGE_DROPBEAR=y
BR2_PACKAGE_IW=y
BR2_PACKAGE_WIRELESS_REGDB=y
BR2_PACKAGE_WPA_SUPPLICANT=y
BR2_PACKAGE_NANO=y
BR2_TARGET_GENERIC_ROOT_PASSWD="12345678"
BR2_TARGET_ROOTFS_CRAMFS=y
BR2_TARGET_ROOTFS_CRAMFS_XIP=y
# BR2_TARGET_ROOTFS_TAR is not set
```
